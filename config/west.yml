## config/west.yml
```yaml
manifest:
  remotes:
    - name: zmkfirmware
      url-base: https://github.com/zmkfirmware
    - name: capnbard
      url-base: https://github.com/maximus5684
  projects:
    - name: zmk
      remote: maximus5684
      revision: feature/sofle_rgb_keyhive
      import: app/west.yml
  self:
    path: config
```
